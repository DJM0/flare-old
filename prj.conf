## CMakeLists.txt
```
set(KCONFIG_ROOT ${CMAKE_CURRENT_SOURCE_DIR}/Kconfig)

include($ENV{ZEPHYR_BASE}/cmake/app/boilerplate.cmake NO_POLICY_SCOPE)
project(NONE)

target_sources(app PRIVATE
    src/main
    src/status
    src/ble/gatt/gatt
    src/ble/gatt/dis
    src/ble/gatt/lcs
)

# Get the current working branch
execute_process(
    COMMAND git rev-parse --abbrev-ref HEAD
    WORKING_DIRECTORY ${CMAKE_SOURCE_DIR}
    OUTPUT_VARIABLE GIT_BRANCH
    OUTPUT_STRIP_TRAILING_WHITESPACE
)

# Get the latest abbreviated commit hash of the working branch
execute_process(
    COMMAND git log -1 --format=%h
    WORKING_DIRECTORY ${CMAKE_SOURCE_DIR}
    OUTPUT_VARIABLE GIT_COMMIT_HASH
    OUTPUT_STRIP_TRAILING_WHITESPACE
)

add_definitions(-DGIT_BRANCH="${GIT_BRANCH}")
add_definitions(-DGIT_COMMIT_HASH="${GIT_COMMIT_HASH}")
```

## Kconfig
```
mainmenu "Flare configuration"

config ZEPHYR_BASE
	string
	option env="ZEPHYR_BASE"

source "$ZEPHYR_BASE/Kconfig.zephyr"

config FLARE_STATUS
	bool
	prompt "Enable flashing status LEDs"
	default n

config FLARE_BLE_GATT
	bool
	prompt "Enable GATT services and characteristics"
	default n
```

## prj.conf
```kconfig
CONFIG_SYS_LOG=y
CONFIG_SYS_LOG_DEFAULT_LEVEL=4

CONFIG_UART_CONSOLE=n
CONFIG_HAS_SEGGER_RTT=y
CONFIG_RTT_CONSOLE=y

CONFIG_BT=y
CONFIG_BT_PERIPHERAL=y
CONFIG_BT_DEVICE_NAME="Flare"
```

## prj_nrf51_ble400.conf
```kconfig
CONFIG_BT=y
CONFIG_BT_PERIPHERAL=y
CONFIG_BT_DEVICE_NAME="Flare"

CONFIG_SYS_LOG=y
CONFIG_SYS_LOG_DEFAULT_LEVEL=4

CONFIG_UART_CONSOLE=y
CONFIG_RTT_CONSOLE=y

CONFIG_FLARE_STATUS=y
CONFIG_FLARE_BLE_GATT=y
```

## prj_nrf51_pca10028.conf
```kconfig
CONFIG_BT=y
CONFIG_BT_PERIPHERAL=y
CONFIG_BT_DEVICE_NAME="Flare"

CONFIG_SYS_LOG=y
CONFIG_SYS_LOG_DEFAULT_LEVEL=4

CONFIG_UART_CONSOLE=n
CONFIG_HAS_SEGGER_RTT=y
CONFIG_RTT_CONSOLE=y

CONFIG_FLARE_STATUS=y
CONFIG_FLARE_BLE_GATT=y
```

## src/main.c
```c
#include <zephyr.h>
#include <logging/sys_log.h>

#if defined(CONFIG_FLARE_STATUS)
#include "status.h"
#endif

#if defined(CONFIG_FLARE_BLE_GATT)
#include "ble/gatt/gatt.h"
#endif

void main(void)
{

    SYS_LOG_INF("Flare 🔥");

    #if defined(CONFIG_FLARE_STATUS)
    status_init();
    #endif

    #if defined(CONFIG_FLARE_BLE_GATT)
    ble_gatt_init();
    #endif

}
```

## src/status.c
```c
#include <board.h>
#include <gpio.h>

#include "status.h"

#define STATUS_SLEEP_TIME 500

#define STATUS_LED_0 LED0_GPIO_PORT
#define STATUS_LED_PIN_0 LED0_GPIO_PIN
#define STATUS_LED_1 LED2_GPIO_PORT
#define STATUS_LED_PIN_1 LED2_GPIO_PIN

#define STATUS_STACK_SIZE 500
#define STATUS_PRIORITY 5

K_THREAD_STACK_DEFINE(status_thread_stack_area, STATUS_STACK_SIZE);

static struct k_thread status_thread_data;

void thread(void *a, void *b, void *c)
{

    u8_t cnt = 0;
    struct device *led_0;
    struct device *led_1;

    led_0 = device_get_binding(STATUS_LED_0);
    led_1 = device_get_binding(STATUS_LED_1);

    gpio_pin_configure(led_0, STATUS_LED_PIN_0, GPIO_DIR_OUT);
    gpio_pin_configure(led_1, STATUS_LED_PIN_1, GPIO_DIR_OUT);

      while (1) {

          gpio_pin_write(led_0, STATUS_LED_PIN_0, cnt % 2);
          gpio_pin_write(led_1, STATUS_LED_PIN_1, cnt % 2 - 1);

          cnt++;

          k_sleep(STATUS_SLEEP_TIME);

      }

}

void status_init()
{

    k_thread_create(
        &status_thread_data, status_thread_stack_area,
        K_THREAD_STACK_SIZEOF(status_thread_stack_area),
        thread,
        NULL, NULL, NULL,
        STATUS_PRIORITY, 0, K_NO_WAIT);

}
```

## src/status.h
```c
#ifndef __STATUS_H__
#define __STATUS_H__

void status_init(void);

#endif
```
